## main/Kconfig.projbuild
```kconfig
menu "Project Configuration"

    config ESP_WIFI_SSID
        string "WiFi SSID"
        default "wifi_ssid"
        help
            SSID (network name) for the example to connect to.

    config ESP_WIFI_PASSWORD
        string "WiFi Password"
        default "wifi_passwd"
        help
            WiFi password (WPA or WPA2) for the example to use.

    config MQTT_USERNAME
        string "MQTT USERNAME"
        default "user"
        help
            MQTT user name credientials
    config MQTT_PASSWD
        string "MQTT_PASSWORD"
        default "password"
        help 
            MQTT password for user
    config MQTT_HOSTNAME
        string "MQTT HOSTNAME"
        default "Your host name"
        help
            Your host IPv4
    config MQTT_PORT
        int "MQTT PORT"
        default 1883
        help 
            MQTT PORT SELECTED


    config TXD_PIN
        int "TXD PIN NUMBER"
        default 17
        
    config RXD_PIN
        int "RXD PIN NUMBER"
        default 16
        

    config STS_LED
        int "STS LED PIN"
        default 22
        
    config BUF_SIZE
        int "BUFFER SIZE"
        default 127
        
    config PIN_NUM_MISO
        int "MISO pin number"
        default 19
        
    config PIN_NUM_MOSI
        int "MOSI pin number"
        default 23
        
    config PIN_NUM_CLK
        int "CLK pin number"
        default 18
        
    config PIN_NUM_CS
        int "CS pin number"
        default 5
        
    config MOUNT_POINT
        string "sdcard mount point"
        default "/sdcard"
        
endmenu
```
